## CMakeLists.txt
```
# SPDX-License-Identifier: MIT

cmake_minimum_required(VERSION 3.28.0)
find_package(Zephyr REQUIRED HINTS $ENV{ZEPHYR_BASE})
project(deskkin_core_s3_inert)
target_sources(app PRIVATE src/main.c)
```

## prj.conf
```kconfig
CONFIG_CONSOLE=y
CONFIG_DISPLAY=y
CONFIG_INPUT=y
CONFIG_MAIN_STACK_SIZE=4096
CONFIG_SERIAL=y
CONFIG_UART_CONSOLE=y
```

## src/main.c
```c
// SPDX-License-Identifier: MIT

#include <zephyr/device.h>
#include <zephyr/drivers/display.h>
#include <zephyr/kernel.h>

int main(void)
{
	const struct device *display = DEVICE_DT_GET(DT_CHOSEN(zephyr_display));
	if (device_is_ready(display)) {
		(void)display_blanking_on(display);
	}
	for (;;) {
		k_sleep(K_FOREVER);
	}
	return 0;
}
```
