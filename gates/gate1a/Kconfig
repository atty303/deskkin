## gates/gate1a/Kconfig
```kconfig
# SPDX-License-Identifier: MIT

mainmenu "Deskkin Gate 1A"

source "Kconfig.zephyr"

config DESKKIN_GATE_MODE
	int "Gate 1A probe mode"
	range 1 2
	default 1
	help
	  Use 1 for the normal completion probe and 2 for the deliberate panic
	  probe. The integer is present in generated Rust Kconfig constants in both
	  modes, unlike a disabled boolean symbol.
```

## gates/gate1b/Kconfig
```kconfig
# SPDX-License-Identifier: GPL-3.0-only

mainmenu "Deskkin Gate 1B"

source "Kconfig.zephyr"
```

## west.yml
```yaml
manifest:
  version: "1.2"

  remotes:
    - name: zephyrproject-rtos
      url-base: https://github.com/zephyrproject-rtos

  projects:
    - name: zephyr
      remote: zephyrproject-rtos
      revision: 1f6485eca25431b5ff27ce9a754218c9e559bbbb
      path: zephyr
      import:
        path-prefix: west
        name-allowlist:
          - cmsis
          - cmsis_6
    - name: zephyr-lang-rust
      remote: zephyrproject-rtos
      revision: dd73abc242e995784da62352fe8c70d9a6c7ac2e
      path: west/modules/lang/rust

  self:
    path: manifest
```
